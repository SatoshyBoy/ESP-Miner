## main/Kconfig.projbuild
```kconfig
menu "Bitaxe Configuration"
    config ASIC_MODEL
        string "ASIC Model"
        default "BM1397"
        help
            Enter the ASIC MODEL BM1397 or BM1366.

    choice BOARD_VERSION
        prompt "Select your Board Version"
        default BITAXE2_A
    
        config BITAXE2_2
            bool "Bitaxe 2.2"
        
        config BITAXE2_A
            bool "Bitaxe 2.A"
    endchoice

    config DEVICE_MODEL
        string "Device Model"
        default "MAX"
        help
            The possible values are MAX or ULTRA.

    config ASIC_VOLTAGE
        int "ASIC Core Voltage (mV)"
        range 1000 1800
        default 1400
        help
            The core voltage to set the ASIC to. 1200 for BM1366 or 1400 for BM1397 is typical.

    config ASIC_POWER
        int "ASIC Power (mW)"
        range 1000 15000
        default 12000
        help
            For safety considerations, always adhere to the maximum power rating of your power supply. Do not exceed values beyond the design specifications of the power source.

    config ASIC_FREQUENCY
        int "ASIC Max Hash Frequency (MHz)"
        range 50 800
        default 500
        help
            The maximum hash frequency
endmenu

menu "Stratum Configuration"

    config STRATUM_URL
        string "Stratum Address"
        default "public-pool.io"
        help
            The example will connect to this Stratum pool address.

    config STRATUM_PORT
        int "Stratum Port"
        range 0 65535
        default 21496
        help
            The stratum server port to connect to.

    config STRATUM_USER
        string "Stratum username"
        default "1A1zP1eP5QGefi2DMPTfTL5SLmv7DivfNa.bitaxe"
        help
            Stratum user to use with pool

    config STRATUM_PW
        string "Stratum password"
        default "x"
        help
            Stratum password to use with pool

    config STRATUM_DIFFICULTY
        int "Stratum default difficulty"
        range 0 4294967296
        default 1000
        help
            A starting difficulty to use with the pool.

endmenu
```
